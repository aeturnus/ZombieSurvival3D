// Lab8.c
// Runs on LM4F120 or TM4C123
// Student names: change this to your names or look very silly
// Last modification date: change this to the last modification date or look very silly
// Last Modified: 3/6/2015 

// Analog Input connected to PE2=ADC1
// displays on Sitronox ST7735
// PF3, PF2, PF1 are heartbeats

#include <stdint.h>

#include "ST7735.h"
#include "../TExaS.h"
#include "../../tm4c123gh6pm.h"
#include "../../brandonware/BrandonTypes.h"
#include "../../brandonware/BrandonMath.h"
#include "../../brandonware/BrandonBufferManager.h"
#include "../../brandonware/BrandonRaycaster.h"
#include "../../drivers/UART.h"
#include "../../drivers/SysTick.h"

#include "print.h"
#include "resource.h"
#include "Music.h"
#include "Interface1.h"

void DisableInterrupts(void); // Disable interrupts
void EnableInterrupts(void);  // Enable interrupts

#define PF1       (*((volatile uint32_t *)0x40025008))
#define PF2       (*((volatile uint32_t *)0x40025010))
#define PF3       (*((volatile uint32_t *)0x40025020))
#define PF_CLEAR(bit) GPIO_PORTF_DATA_R = GPIO_PORTF_DATA_R &(~(0x01<<bit))
#define PF_SET(bit) GPIO_PORTF_DATA_R |= (0x01<<bit)
#define PF_EOR(bit) GPIO_PORTF_DATA_R ^= (0x01<<bit)
#define PF_GET(bit) ((GPIO_PORTF_DATA_R & (0x01<<bit))>>bit)
#define W_WIDTH 40
#define W_HEIGHT 40
uint8_t worldArray[] =
{
    0x30,0x30,0x30,0x30,0x30,0x30,0x30,0x30,0x30,0x30,0x30,0x30,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0x30,
    0x30,0x00,0x00,0x00,0x00,0x00,0x00,0x00,0x00,0x00,0x00,0x00,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0x30,
    0x30,0x00,0x00,0x00,0x00,0x00,0x00,0x00,0x00,0x00,0x00,0x00,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0x30,
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    0x30,0x30,0x30,0x30,0x30,0x30,0x30,0x30,0x30,0x30,0x30,0x30,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0x30
};
#define COLUMNS 160
#define ROWS 90
#define HEIGHT 160
camera myCamera;
world myWorld;
ray rayArray[COLUMNS];
fixed32_3 x = 15000;
fixed32_3 y = 15000;
fixed32_3 rot = 90000;
fixed32_3 paces = 0;

void systick(void)
{
  SysTick_DisableAll();
  Interface1_GetInput();
  
  PF_EOR(2);
  Interface1_ClearBuffer();
  
  RC_CastRays(&myCamera,&myWorld);
  //Interface1_ScaleSpriteOver(120,10,1000,1000,0);
  //for(uint32_t i = 0; i<0xFFFFF; i++);
  uint32_t i;
  int32_t height;
  uint16_t color;
  for(i = 0; i < COLUMNS; i++)
  {
    height = (HEIGHT+1) - (14 * (myCamera.rayArray[i].distance)/10000);
    if(height <0){height = 0;}
    if(height>0)
    {
      if(myCamera.rayArray[i].wallMeta & X_HIT)
      {
        Interface1_DrawLine(i,HEIGHT/2-height/2,i,height/2,0xFFFF);
      }
      else
      {
        Interface1_DrawLine(i,HEIGHT/2-height/2,i,height/2,0x7777);
      }
    }
  }
  //Interface1_DrawBitmap(120,0,27,33,0);
  //Interface1_ScaleBitmap(127,0,27,33,2000,2000,0);
  //Interface1_DrawSpriteOver(120+sineFix(paces<<6)/256,10+cosineFix(paces<<8)/256,0);
  Interface1_ScaleSpriteOver(80,45,1000,1000,1);
  Interface1_ScaleSpriteOver(120+sineFix(paces<<6)/256,10+cosineFix(paces<<8)/256,1000,1000,0);
  //Interface1_ScaleSpriteOver(120,10,1000,1000,0);
  Interface1_DrawBuffer();
  
  /*
  myCamera.direction += 100;
  myCamera.pos.x += 100;
  myCamera.pos.y += 100;
  */
  
  
  myCamera.direction += Interface1_GetAnalog('x')*5;
  myCamera.pos.x += mul32_3(Interface1_GetAnalog('y'),cosineFix(myCamera.direction))/2;
  myCamera.pos.y += mul32_3(Interface1_GetAnalog('y'),sineFix(myCamera.direction))/2;
  paces += mul32_3(Interface1_GetAnalog('y'),500);
  
  
  SysTick_Clear();
  SysTick_EnableAll();
  
  
}

// Initialize Port F so PF1, PF2 and PF3 are heartbeats,PF0 and PF4 are inputs
void PortF_Init(void)
{
  SYSCTL_RCGCGPIO_R |= 0x20; //Enable clock
  while((SYSCTL_RCGCGPIO_R & 0x20) == 0){};
  GPIO_PORTF_AMSEL_R = (GPIO_PORTF_AMSEL_R&~0x1F);
  GPIO_PORTF_AFSEL_R = (GPIO_PORTF_AFSEL_R&~0x1F);
  GPIO_PORTF_DIR_R |= 0x0E;
  GPIO_PORTF_PCTL_R = GPIO_PORTF_PCTL_R&(~0x000FFFFF);
  GPIO_PORTF_DEN_R |= 0x1F;
  GPIO_PORTF_PUR_R |= 0x11; //Enable pullup resistors
}


int main(void)
{
  //Hardware Inits
  //TExaS_Init();
  PLL_Init();
  PortF_Init();
  SysTick_Init(WAIT_1MS * 50,2,&systick);
  SysTick_DisableAll();
  Interface1_Init();
  Music_Init();
  PF_CLEAR(2);
  //PF_EOR(1);  //Heartbeat
  /*
  Music_Init();
  Music_LoadSong(1);
  Music_PlaySong();
  */
  
  RC_InitWorld(&myWorld,worldArray,W_WIDTH,W_HEIGHT);
  RC_InitCamera(&myCamera,x,y,rot,90000,COLUMNS,ROWS,64000,rayArray);
  SysTick_Clear();
  for(uint32_t i = 0; i< 0xFFFFF;i++)
  {
  }
  Interface1_FillRect(0,0,160,90,0xFFFF);
  Interface1_ScaleSpriteOver(80,45,500,500,0);
  Interface1_ScaleSpriteOver(90,45,1000,1000,0);
  Interface1_ScaleSpriteOver(40,75,2000,2000,0);
  Interface1_DrawBuffer();
  Music_LoadSong(2);
  Music_PlaySong();
  SysTick_EnableAll();
  
  
  while(1){
    PF_EOR(1);  //Heartbeat
  }
  return 0;
}
